## config/west.yml
```yaml
manifest:
  remotes:
    - name: zmkfirmware
      url-base: https://github.com/zmkfirmware
    - name: kumamuk-git
      url-base: https://github.com/kumamuk-git
    - name: ultimateblanks-collab
      url-base: https://github.com/ultimateblanks-collab
  projects:
    - name: zmk
      remote: zmkfirmware
      revision: v0.3-branch
      import: app/west.yml
    - name: zmk-pmw3610-driver
      remote: ultimateblanks-collab
      revision: main
    - name: zmk-scroll-snap
      remote: ultimateblanks-collab
      revision: v1
  self:
    path: config
```
